
#include <vm_arduino.h>

#ifndef USE_SD_XCP
const unsigned char xcp_code[] =
{
0x1C,0x15,0x00,0x00, 0x01,0x00,0x1C,0x15, 0x01,0x00,0x01,0x00, 0x1C,0x15,0x02,0x00,
0x02,0x00,0x00,0x1C, 0x16,0x00,0x00,0x08, 0x01,0x1C,0x16,0x00, 0x00,0x34,0x01,0x1C,
0x1D,0x19,0x00,0x1C, 0x15,0x0C,0x00,0x04, 0x00,0x00,0x00,0x00, 0x1C,0x15,0x01,0x00,
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0x01,0x00,0x1C,0x13
};
#endif

VMArduino cpdev;

#define LEDPIN    2 //LED_BUILTIN
#define BUTTONPIN 6

// Addresses of CPDev variables
#define ONOFF_ADDRESS 0
#define LIGHT_ADDRESS 1

void setup()
{
  Serial.begin(9600);
  while(!Serial);

#ifdef USE_SD_XCP
  if (cpdev.VMP_LoadProgramAndData(L"blink.xcp") != 0)    // note that SD library supports short (8+3) filenames only
#else
  if (cpdev.VMP_LoadProgramFromArray(xcp_code) != 0)
#endif  
  {
    Serial.print("Cannot load program into VM");
    while (1);
  }
  else
  {
    cpdev.task_cycle = 100;
    cpdev.WM_Initialize(WM_MODE_FIRST_START | WM_MODE_NORMAL);
    pinMode(LED_BUILTIN, OUTPUT);
    pinMode(1, INPUT_PULLUP);
  }
}

void loop()
{
  WM_BYTE light, button;

  if (cpdev.bRunMode)
  {
    button = digitalRead(BUTTONPIN);  // or set to 1 if you dont have a pushbutton
    cpdev.WM_SetData(ONOFF_ADDRESS, sizeof(button), &button);
    cpdev.WM_RunCycle();
    cpdev.WM_GetData(LIGHT_ADDRESS, sizeof(light), &light);
    digitalWrite(LEDPIN, light);
  }
  else
    cpdev.WM_Shutdown();

}
